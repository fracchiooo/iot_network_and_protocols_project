## secure_com_node/main/Kconfig.projbuild
```kconfig
menu "Project Configuration Options"

config WIFI_SSID
    string "ID WiFi"
    default "OnePlus Nord"
    
config WIFI_PASS
    string "WiFi password"
    default "123456789"
    
config BROKER_URI
    string "MQTT broker URI"
    default "mqtts://uri_to_broker"  
    
endmenu
```
